/dts-v1/;
/plugin/;

/ {
	compatible = "brcm,bcm2835";
	fragment@0 {
		target = <&spidev0>;
		__overlay__ {
			status = "disabled";
		};
	};
		
	fragment@1 {
		target = <&spi0>;
		__overlay__ {
			status = "okay";
			#address-cells = <1>;
			#size-cells = <0>;

			nrf7002_ek: nrf7002@0 {
				compatible = "nordic,nrf7002";
				reg = <0x0>;
				spi-max-frequency = <31200000>;
				spi-bits-per-word = <8>;
				status = "okay";
				bucken-gpio = <&gpio 16 0>;
				iovdd-gpio = <&gpio 20 0>;
				irq-gpio = <&gpio 12 0>;  
			
			};
		};
	};
};
